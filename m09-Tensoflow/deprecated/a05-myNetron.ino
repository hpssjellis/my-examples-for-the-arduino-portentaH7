
// This allows only one file for Arduino IDE, but you should seperate the following
// #include "model.h"  // the following should be in it's own tab. Then uncomment this

/////////////////////////////////// cut and paste to model.h tab /////////////////////////////////////////////////////////////////



#pragma once

const unsigned char model_tflite[] = {
  0x1c, 0x00, 0x00, 0x00, 0x54, 0x46, 0x4c, 0x33, 0x00, 0x00, 0x12, 0x00,
  0x1c, 0x00, 0x04, 0x00, 0x08, 0x00, 0x0c, 0x00, 0x10, 0x00, 0x14, 0x00,
  0x00, 0x00, 0x18, 0x00, 0x12, 0x00, 0x00, 0x00, 0x03, 0x00, 0x00, 0x00,
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  0xfc, 0xff, 0xff, 0xff, 0x04, 0x00, 0x04, 0x00, 0x04, 0x00, 0x00, 0x00
};
unsigned int model_tflite_len = 1608;



//////////////////////////////////// end cut and paste to model.h tab ///////////////////////////////////////////////////////////////

#include "Arduino.h"
#include <TensorFlowLite.h>



/*================= Start Advanced Area ===============================*/

#include "tensorflow/lite/micro/all_ops_resolver.h"
//#include "tensorflow/lite/micro/kernels/micro_ops.h"
//#include "tensorflow/lite/micro/micro_mutable_op_resolver.h"

#include "tensorflow/lite/micro/micro_error_reporter.h"  // may have issues on M4 core
#include "tensorflow/lite/micro/micro_interpreter.h"
#include "tensorflow/lite/schema/schema_generated.h"
#include "tensorflow/lite/version.h"
#include "tensorflow/lite/c/common.h"
//#include "tensorflow/lite/c/c_api.h" // has interesting funcitons, not in main library


// Start Debug.cc information    ----------------------------------------------------------

 #if  defined (CORE_CM7)  ||  defined (YOUR_BOARD1) // CORE_CM7 is for the PortentaH7 outer core
 
    // do abosolutely nothing the default works
    
 #elif defined (CORE_CM4)  || defined (NANO_33_BLE) ||  defined (YOUR_BOARD2)  // CORE_CM4 is for the PortentaH7 inner core
 
     #define DEBUG_SERIAL_OBJECT (Serial) 

     extern "C" void DebugLog(const char* s) {
        static bool is_initialized = false;
        if (!is_initialized) {
           DEBUG_SERIAL_OBJECT.begin(9600);
          is_initialized = true;
        }
        DEBUG_SERIAL_OBJECT.print(s);
     }

 #elif defined (__SAM3X8E__)  ||  defined (YOUR_BOARD3) 

     #define DEBUG_SERIAL_OBJECT (SerialUSB) 

     extern "C" void DebugLog(const char* s) {
        static bool is_initialized = false;
        if (!is_initialized) {
           DEBUG_SERIAL_OBJECT.begin(9600);
          is_initialized = true;
        }
        DEBUG_SERIAL_OBJECT.print(s);
     }

 #else
   // don't do any debugging until you figure out your board    
   extern "C" void DebugLog(const char* s) {
     // Do not log debug info
   } 
 #endif


/*
 * seeed_XIAO_m0.build.board=SEEED_XIAO_M0
 * 
 * nano_33_iot.build.board=SAMD_NANO_33_IOT
 * 
//potentiall the default

extern "C" void DebugLog(const char* s) {
  asm("mov r0, #0x04\n"  // SYS_WRITE0
      "mov r1, %[str]\n"
      "bkpt #0xAB\n"
      :
      : [ str ] "r"(s)
      : "r0", "r1");
}


or this for mbed

#include <mbed.h>

// On mbed platforms, we set up a serial port and write to it for debug logging.
extern "C" void DebugLog(const char* s) {
  static Serial pc(USBTX, USBRX);
  pc.printf("%s", s);
}



or

#include <stdio.h>

extern "C" void DebugLog(const char* s) { puts(s); }

or


#include <cstdio>
extern "C" void DebugLog(const char* s) { printf("%s", s); }

*/

// End Debug.cc information    ----------------------------------------------------------


// Globals, used for compatibility with Arduino-style sketches.

namespace { // Start namespace----------------------------------------------------------

/*
 * 
///  ErrorReporter foo;
///  foo.Report("test %d", 5);
///  va_list args;
///  foo.Report("test %d", args); // where args is va_list

// Hopefully this negates the error reporter???
class ErrorReporter {
 public:
  virtual ~ErrorReporter() {}
  virtual int Report(const char* format, va_list args) = 0;
  int Report(const char* format, ...);
  int ReportError(void*, const char* format, ...);
};

*/
  
tflite::ErrorReporter* error_reporter = nullptr;

const tflite::Model* model = nullptr;

tflite::MicroInterpreter* interpreter = nullptr;

TfLiteTensor* input = nullptr;

TfLiteTensor* output = nullptr;

// Create an area of memory to use for input, output, and intermediate arrays.
constexpr int kTensorArenaSize = 2 * 1024;  // I like 20 * 1024;

uint8_t tensor_arena[kTensorArenaSize];



}  // END namespace----------------------------------------------------------





/*================= End Advanced Area ===============================*/







// helper function to convert tensor type integer to a string
String myTypeIntToString(int myType){
  
  String myTensorType = "Not Set";    
   if (myType == 0){myTensorType  = "kTfLiteNoType"; }  
   if (myType == 1){myTensorType  = "kTfLiteFloat32"; }  
   if (myType == 2){myTensorType  = "kTfLiteInt32"; }   
   if (myType == 3){myTensorType  = "kTfLiteUInt8"; }   
   if (myType == 4){myTensorType  = "kTfLiteInt64"; }   
   if (myType == 5){myTensorType  = "kTfLiteString"; }  
   if (myType == 6){myTensorType  = "kTfLiteBool"; }    
   if (myType == 7){myTensorType  = "kTfLiteInt16"; }    
   if (myType == 8){myTensorType  = "kTfLiteComplex64"; }    
   if (myType == 9){myTensorType  = "kTfLiteInt8"; }    
   if (myType == 10){myTensorType = "kTfLiteFloat16"; }    
   if (myType == 11){myTensorType = "kTfLiteFloat64"; }   
   if (myType == 12){myTensorType = "kTfLiteComplex128"; }  
   return myTensorType;
  
}







void setup() {
  Serial.begin(9600);


  // NOLINTNEXTLINE(runtime-global-variables)
  
  static tflite::MicroErrorReporter micro_error_reporter;
  error_reporter = &micro_error_reporter;  // lets not do this

  // Map the model into a usable data structure. This doesn't involve any
  // copying or parsing, it's a very lightweight operation.


  model = tflite::GetModel(model_tflite);  // name from the tflite converter model.h file


  
  if (model->version() != TFLITE_SCHEMA_VERSION) {
    TF_LITE_REPORT_ERROR(error_reporter,
                         "Model provided is schema version %d not equal "
                         "to supported version %d.",
                         model->version(), TFLITE_SCHEMA_VERSION);
    return;
  }

  // This pulls in all the operation implementations we need.
  // NOLINTNEXTLINE(runtime-global-variables)
  
  static tflite::AllOpsResolver resolver;


  /* // replace the above line if you know each operation to save space
   * 
  
  static tflite::MicroMutableOpResolver<5> micro_op_resolver;  // NOLINT
  micro_op_resolver.AddBuiltin(tflite::BuiltinOperator_DEPTHWISE_CONV_2D,tflite::ops::micro::Register_DEPTHWISE_CONV_2D() );
  micro_op_resolver.AddBuiltin(tflite::BuiltinOperator_MAX_POOL_2D,tflite::ops::micro::Register_MAX_POOL_2D() );
  micro_op_resolver.AddBuiltin(tflite::BuiltinOperator_CONV_2D,tflite::ops::micro::Register_CONV_2D() );
  micro_op_resolver.AddBuiltin(tflite::BuiltinOperator_FULLY_CONNECTED,tflite::ops::micro::Register_FULLY_CONNECTED() );
  micro_op_resolver.AddBuiltin(tflite::BuiltinOperator_SOFTMAX,tflite::ops::micro::Register_SOFTMAX() );



   * 
   */



  // Build an interpreter to run the model with.
  static tflite::MicroInterpreter static_interpreter(model, resolver, tensor_arena, kTensorArenaSize, error_reporter);
  
  interpreter = &static_interpreter;

  // Allocate memory from the tensor_arena for the model's tensors.
  TfLiteStatus allocate_status = interpreter->AllocateTensors();
  
  if (allocate_status != kTfLiteOk) {
    TF_LITE_REPORT_ERROR(error_reporter, "AllocateTensors() failed");
    return;
  }

  // Obtain pointers to the model's input and output tensors.
  input = interpreter->input(0);
  output = interpreter->output(0);


}






// The name of this function is important for Arduino compatibility.
void loop() {
   
   Serial.println("  constexpr int kTensorArenaSize: " + String(kTensorArenaSize) );
   Serial.println(" interpreter->arena_used_bytes(): " + String(interpreter->arena_used_bytes()) );
  
   Serial.println("       interpreter.inputs_size(): " + String(interpreter->inputs_size()) );
   Serial.println("       interpreter.outputs_size(): " + String(interpreter->outputs_size()) );
   Serial.println("       interpreter.tensors_size(): " + String(interpreter->tensors_size()) );
   
   Serial.println();
   Serial.println("                     input->type: " + String(input->type) + " = " + myTypeIntToString(input->type));
   Serial.println("               input->dims->size: " + String(input->dims->size) );
   int mySize = input->dims->size;
  
   for (int i = 0; i < mySize; i++) {
     int myIn = input->dims->data[i]; 
     Serial.println( "            input->dims->data[" + String(i) + "]: " + String(myIn) );
       
   }

   Serial.println(  );
   Serial.println("-----------------------------------------------------------" );

   int myTotalBytes = 0;
   for (size_t tensor_index = 0; tensor_index < interpreter->tensors_size(); tensor_index++) {
    TfLiteTensor* tensor = interpreter->tensor(static_cast<int>(tensor_index));
    Serial.print("Layer index: " + String(tensor_index) );
    Serial.print(",  Type: " + String(tensor->type)+ ": "+ myTypeIntToString(tensor->type) );
    Serial.print(",  # Nodes: " + String(tensor->dims->size) );
    Serial.println(",  Size in Bytes: " + String(tensor->bytes) );
    myTotalBytes += tensor->bytes; 
    Serial.print("-----tensor->dims->data[k]" );
    
    for (int k = 0; k < tensor->dims->size; k++) {
       Serial.print(",    data[" + String(k) + "]:" + String(tensor->dims->data[k]));
    }
    Serial.println( );    
    Serial.println( );
 }

   Serial.println("-----------------------------------------------------------" );

   Serial.println("                     output->type: " + String(output->type) + " = " + myTypeIntToString(output->type));
   Serial.println("               output->dims->size: " + String(output->dims->size) );
   
   int mySize2 = output->dims->size;
   for (int i = 0; i < mySize2; i++) {
     int myOut = output->dims->data[i];      
     Serial.println( "            output->dims->data[" + String(i) + "]: " + String(myOut) );
   }

   Serial.println("              Total Added Bytes: " + String(myTotalBytes) );
   Serial.println("-----------------------------------------------------------" );
   Serial.println("-----------------------------------------------------------" );  
   Serial.println();
  

  delay(3000);
  
}
